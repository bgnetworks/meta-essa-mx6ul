## conf/layer.conf
```bitbake
# We have a conf and classes directory, add to BBPATH
BBPATH .= ":${LAYERDIR}"

# We have recipes-* directories, add to BBFILES
BBFILES += "${LAYERDIR}/recipes-*/*/*.bb \
            ${LAYERDIR}/recipes-*/*/*.bbappend"

BBFILE_COLLECTIONS += "essa-6ul"
BBFILE_PATTERN_essa-6ul = "^${LAYERDIR}/"

BBFILE_PRIORITY_essa-6ul = "13"

# NOTE: IMAGE_INSTALL += is not working for some weird reason,
#       use IMAGE_INSTALL_append

# userspace packages for dm-crypt
# Don't use += (creates weird issues) and use _append =
IMAGE_INSTALL_append = " libgcc"
IMAGE_INSTALL_append = " udev"
IMAGE_INSTALL_append = " lvm2"
# Install mke2fs for creating ext4 filesystems
IMAGE_INSTALL_append = " e2fsprogs-mke2fs"
IMAGE_INSTALL_append = " coreutils"
IMAGE_INSTALL_append = " keyutils"
IMAGE_INSTALL_append = " util-linux"
IMAGE_INSTALL_append = " cryptodev-module"
# userspace packages for dm-crypt
IMAGE_INSTALL_append = " cryptsetup"
# Adding init script for cryptsetup
IMAGE_INSTALL_append = " sys-setup"
IMAGE_INSTALL_append = " caam-keygen"
# Adding ZModem utility
IMAGE_INSTALL_append = " lrzsz"

# Changing the WKS file to add DM partition
WKS_FILE_imx6ulevk = "imx-bootpart-dm.wks.in"

LAYERDEPENDS_essa-6ul = "core"
LAYERSERIES_COMPAT_essa-6ul = "hardknott"
```
